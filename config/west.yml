## config/west.yml
```yaml
manifest:
  remotes:
    - name: partydonut
      url-base: https://github.com/PartyDonut
  projects:
    - name: zmk
      remote: partydonut
      revision: main
      import: app/west.yml
    - name: zmk-rgb-matrix
      remote: partydonut
      revision: rgb-changes
  self:
    path: config
```
